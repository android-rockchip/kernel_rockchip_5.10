// SPDX-License-Identifier: (GPL-2.0+ OR MIT)
/*
 * Copyright (c) 2021 Rockchip Electronics Co., Ltd.
 *
 */

/dts-v1/;

#include "rk3588-orangepi-5-plus.dts"
#include "rk3588-orangepi-5-plus-lcd.dtsi"
