// SPDX-License-Identifier: (GPL-2.0+ OR MIT)
/*
 * Copyright (c) 2021 Rockchip Electronics Co., Ltd.
 *
 */

/dts-v1/;

#include "rk3588s-orangepi-5.dts"

/ {
	model = "Orange Pi 5B";
	compatible = "rockchip,rk3588s-orangepi-5", "rockchip,rk3588";

};

/delete-node/ &vcc3v3_pcie2x1l2;

&pcie2x1l2 {
	/delete-property/ vpcie3v3-supply;
};

&wireless_bluetooth {
	BT,wake_host_irq = <&gpio0 RK_PC5 GPIO_ACTIVE_HIGH>;
};

&bt_gpio {
	rockchip,pins =
		<3 RK_PA6 RK_FUNC_GPIO &pcfg_pull_none>,
		<0 RK_PC5 RK_FUNC_GPIO &pcfg_pull_none>,
		<0 RK_PC6 RK_FUNC_GPIO &pcfg_pull_none>;
};
